## devices/inverter/growatt-es/Kconfig
```kconfig
menu "RoboHub Growatt inverter"

config RH_DEV_GROWATT_ES
    bool "Growatt inverter over Modbus (default map: SPF ES Plus)"
    select RH_MODBUS
    default n
    help
      A Growatt inverter read over Modbus RTU, presenting the
      RoboHubInverter device interface. The default register map is the
      SPF 3000-6000 ES Plus (off-grid RS485 protocol V0.26).

endmenu
```

## devices/plug/sonoff-s60tpf/Kconfig
```kconfig
menu "RoboHub Sonoff S60TPF (Tasmota)"

config RH_DEV_SONOFF_S60TPF
    bool "Sonoff S60TPF reflashed with Tasmota"
    select RH_JSON
    select RH_MQTT
    default n
    help
      A Sonoff S60TPF Wi-Fi plug reflashed with Tasmota (tasmota32c3), as a
      switch and power meter over MQTT. Stock eWeLink firmware is not
      supported.

endmenu
```

## apps/smart-plug/Kconfig
```kconfig
# smart-plug — the custom device's configuration.

config RH_HAL_UART
    bool "UART"
    default y

config RH_HAL_GPIO
    bool "GPIO"
    default y

config RH_HAL_TIMER
    bool "Timer"
    default y

config RH_HAL_ONEWIRE
    bool "OneWire"
    default y

config RH_CORE
    bool "Runtime (robohub-core)"
    default y

config RH_TRANSPORT
    bool "Transport framing"
    default y

config RH_TELEMETRY
    bool "Telemetry bridge"
    default y

config RH_DEVICE_NODE
    bool "Device node runtime"
    default y

config RH_DEV_RELAY
    bool "Relay (GPIO switch)"
    default y

config RH_DRV_DS18B20
    bool "DS18B20 temperature driver"
    default y

config RH_BOARD_PICO_2W
    bool "Pico 2W"
    default y
```

## devices/actuator/relay/Kconfig
```kconfig
menu "RoboHub relay"

config RH_DEV_RELAY
    bool "Relay (GPIO switch)"
    select RH_HAL_GPIO
    default n
    help
      A relay or any on/off output over a GPIO, presenting the RoboHubSwitch
      interface.

endmenu
```

## devices/inverter/growatt-es/Kconfig
```kconfig
menu "RoboHub Growatt inverter"

config RH_DEV_GROWATT_ES
    bool "Growatt SPH/ES hybrid inverter (Modbus)"
    select RH_MODBUS
    default n
    help
      A Growatt hybrid inverter read over Modbus RTU, presenting the
      RoboHubInverter device interface.

endmenu
```

## devices/inverter/hoymiles-hms/Kconfig
```kconfig
menu "RoboHub Hoymiles inverter"

config RH_DEV_HOYMILES_HMS
    bool "Hoymiles microinverter via OpenDTU (HTTP)"
    select RH_HTTP
    select RH_JSON
    select RH_NET
    default n
    help
      A Hoymiles microinverter read through an OpenDTU's HTTP status document,
      presenting the RoboHubInverter device interface.

endmenu
```

## devices/plug/shelly-plug-m-gen3/Kconfig
```kconfig
menu "RoboHub Shelly Plug M Gen3"

config RH_DEV_SHELLY_PLUG_M_GEN3
    bool "Shelly Plug M Gen3"
    select RH_HTTP
    select RH_JSON
    select RH_MQTT
    default n
    help
      A Shelly Plug M Gen3 as a switch and power meter, over HTTP JSON-RPC or
      MQTT.

endmenu
```

## nodes/gateway-node/Kconfig
```kconfig
# gateway-node — the device node's configuration.

config RH_HAL_UART
    bool "UART"
    default y

config RH_HAL_RS485
    bool "RS485"
    default y

config RH_HAL_TIMER
    bool "Timer"
    default y

config RH_HAL_GPIO
    bool "GPIO"
    default y

config RH_NET
    bool "Network"
    default y

config RH_BOARD_MAX485_MODULE
    bool "MAX485 RS485 transceiver carrier"
    default y

config RH_DEV_GROWATT_ES
    bool "Growatt SPH/ES hybrid inverter"
    default y

config RH_DEV_HOYMILES_HMS
    bool "Hoymiles microinverter via OpenDTU"
    default y
```

## protocols/http/Kconfig
```kconfig
menu "RoboHub HTTP"

config RH_HTTP
    bool "HTTP client"
    select RH_NET
    default n
    help
      A small HTTP GET over the network contract, for reading a device that
      answers over IP.

endmenu
```

## protocols/json/Kconfig
```kconfig
menu "RoboHub JSON"

config RH_JSON
    bool "JSON field reader"
    default n
    help
      A small reader for named fields of a JSON document, for an IP device's
      status reply.

endmenu
```

## protocols/modbus/Kconfig
```kconfig
menu "RoboHub Modbus"

config RH_MODBUS
    bool "Modbus RTU master"
    select RH_HAL_RS485
    default n
    help
      A Modbus RTU master over the RS485 HAL. A device module that reads a
      Modbus device selects this; nothing else pays for it.

endmenu
```

## protocols/mqtt/Kconfig
```kconfig
menu "RoboHub MQTT"

config RH_MQTT
    bool "MQTT client seam"
    select RH_NET
    default n
    help
      The MQTT interface a device integration publishes and subscribes through.
      The platform supplies the broker client; this is the seam.

endmenu
```

## runtime/device-node/Kconfig
```kconfig
menu "RoboHub device node runtime"

config RH_DEVICE_NODE
    bool "Device node runtime"
    select RH_CORE
    select RH_TRANSPORT
    select RH_TELEMETRY
    default n
    help
      The runtime a device node is built on: the link, the telemetry bridge,
      publishing a reading and dispatching a control request to the device it
      names.

endmenu
```
